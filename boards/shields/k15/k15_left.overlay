#include "k15.dtsi"

// Left ROW2 wire: TP03 -> P1.06 (pad marked 106).
&k15_kscan {
    row-gpios = <&gpio0 17 (GPIO_ACTIVE_HIGH | GPIO_PULL_DOWN)>,
                <&gpio0 20 (GPIO_ACTIVE_HIGH | GPIO_PULL_DOWN)>,
                <&gpio1 6 (GPIO_ACTIVE_HIGH | GPIO_PULL_DOWN)>,
                <&gpio0 24 (GPIO_ACTIVE_HIGH | GPIO_PULL_DOWN)>,
                <&gpio1 0 (GPIO_ACTIVE_HIGH | GPIO_PULL_DOWN)>;
};
