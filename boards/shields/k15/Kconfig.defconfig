## boards/shields/k15/Kconfig.defconfig
```kconfig
if SHIELD_K15_LEFT
config ZMK_KEYBOARD_NAME
    default "K15 RevC"
config ZMK_SPLIT_ROLE_CENTRAL
    default y
endif

if SHIELD_K15_LEFT || SHIELD_K15_RIGHT
config ZMK_SPLIT
    default y
endif
```

## boards/shields/k15/Kconfig.shield
```kconfig
config SHIELD_K15_LEFT
    def_bool $(shields_list_contains,k15_left)

config SHIELD_K15_RIGHT
    def_bool $(shields_list_contains,k15_right)
```
